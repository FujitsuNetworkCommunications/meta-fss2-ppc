## conf/layer.conf
```bitbake
# We have a conf and classes directory, add to BBPATH
BBPATH .= ":${LAYERDIR}"

# We have recipes-* directories, add to BBFILES
BBFILES += "${LAYERDIR}/recipes-*/*/*.bb \
	${LAYERDIR}/recipes-*/*/*.bbappend"

BBFILE_COLLECTIONS += "fss2-ppc"
BBFILE_PATTERN_fss2-ppc = "^${LAYERDIR}/"
BBFILE_PRIORITY_fss2-ppc = "7"

# Platform Yocto 2.3 recipes that conflict with Yocto 1.6 recipes.
PPC_DAISY_BBMASK = "meta-fss2-ppc/recipes-kernel/linux/linux-qoriq_4.1.bbappend"

# Platform Yocto 1.6 recipes that conflict with Yocto 2.3 recipes.
PPC_PYRO_BBMASK += "meta-fss2-ppc/recipes-kernel/linux/linux-qoriq_3.12.bb"
PPC_PYRO_BBMASK += "meta-fss2-ppc/recipes-kernel/linux/linux-qoriq_3.12.bbappend"

BBMASK += "${@bb.utils.contains('DISTRO_CODENAME', 'daisy', "${PPC_DAISY_BBMASK}", "${PPC_PYRO_BBMASK}", d)}"
```

## conf/machine/t600.conf
```bitbake
#@TYPE: Machine
#@DESCRIPTION: Machine configuration for running T600 in 32-bit mode

# TODO: Change back to require once Yocto 1.6 support is removed.
include conf/machine/e6500.inc
include conf/machine/include/e6500.inc
require conf/machine/include/soc-family.inc

PREFERRED_PROVIDER_u-boot = "u-boot-qoriq"
PREFERRED_PROVIDER_virtual/bootloader = "u-boot-qoriq"

# Freescale's qoriq-base.inc adds in u-boot and cst-native as part of
# all image builds.
#
# If using a pre-built u-boot binary blob and support tools then reset
# EXTRA_IMAGEDEPENDS back to empty list.
EXTRA_IMAGEDEPENDS = ""

PREFERRED_PROVIDER_virtual/kernel = "linux-qoriq"

SOC_FAMILY = "t2080"
UBOOT_MACHINE = "T2080QDS_config"
# Exact machine is not important for fw utils so use one that
# exists in daisy.
UBOOT_MACHINE_pn-u-boot-fw-utils = "P2041RDB_config"
KERNEL_DEVICETREE ?= "t2080qds.dtb t2080qds-usdpaa.dtb"
KERNEL_DEFCONFIG ?= "${@bb.utils.contains('DISTRO_CODENAME', 'daisy', "${S}/arch/powerpc/configs/85xx/e6500rev2_defconfig" , "${S}/arch/powerpc/configs/corenet64_fmanv3h_smp_defconfig", d)}"

JFFS2_ERASEBLOCK = "0x10000"

SERIAL_CONSOLES = "115200;ttyS0 115200;ttyS1 115200;ttyEHV0"
SERIAL_CONSOLES_CHECK = "${SERIAL_CONSOLES}"
USE_VT = "0"

BUILD_64BIT_KERNEL = "1"
```
